// SPDX-License-Identifier: GPL-2.0-only
// SPDX-FileCopyrightText: Copyright (c) 2026, ARK Electronics.

/*
 * Body of the FLIR Hadron EO (OV64B40) sensor node. Include it inside the
 * node, after reset-gpios, once tegra234-camera-hadron-eo.dtsi is in scope.
 *
 * TODO(driver): nothing binds "ovti,ov64b40" yet. L4T has no OV64B40
 * driver and the register tables are not public (FLIR's Jetson package is
 * ticket-only and targets the Jetson Nano through an ISP board). A tegracam
 * driver under kernel_overlay/ needs the init and mode tables from FLIR or
 * OmniVision; until then the overlay describes the hardware but streams
 * nothing.
 *
 * I2C_CAM also carries the Boson CCI (0x6a) and two EEPROMs (0x50, 0x51).
 * The sensor answers on its second SCCB ID, 0x21, as well.
 */

compatible = "ovti,ov64b40";
reg = <0x36>;
devnode = "video0";
/* 9248 x 6944 at 0.701 um */
physical_w = "6.483";
physical_h = "4.868";
sensor_model = "ov64b40";
use_sensor_mode_id = "true";

/*
 * x4: the Hadron EO modes ModalAI runs on VOXL2 (resolution, frame rate,
 * Mbps/lane); pix_clk_hz = lane rate * 4 / 10 bpp.
 * x2: the same per-lane rates on half the lanes, so half the frame rate.
 * TODO(driver): x2 is untested on any platform; drop it if FLIR's tables
 * are 4-lane only.
 */
#if HADRON_EO_LANES == 4
/* 4624x3472 @ 30, 4-cell binned, 1502 Mbps/lane */
HADRON_EO_MODE(mode0, 4624, 3472, 600800000, 5715, 25.03, 30000000, 33000);
/* 3840x2160 @ 60, 2500.8 Mbps/lane */
HADRON_EO_MODE(mode1, 3840, 2160, 1000320000, 7605, 41.68, 60000000, 16500);
/* 1920x1080 @ 30, 800 Mbps/lane */
HADRON_EO_MODE(mode2, 1920, 1080, 320000000, 9592, 13.33, 30000000, 33000);
/* 9248x6944 @ 10, full array, 2500.8 Mbps/lane */
HADRON_EO_MODE(mode3, 9248, 6944, 1000320000, 14339, 41.68, 10000000, 99000);
#else
/* 4624x3472 @ 15, 4-cell binned, 1502 Mbps/lane */
HADRON_EO_MODE(mode0, 4624, 3472, 300400000, 5715, 12.52, 15000000, 66000);
/* 3840x2160 @ 30, 2500.8 Mbps/lane */
HADRON_EO_MODE(mode1, 3840, 2160, 500160000, 7605, 20.84, 30000000, 33000);
/* 1920x1080 @ 15, 800 Mbps/lane */
HADRON_EO_MODE(mode2, 1920, 1080, 160000000, 9592, 6.67, 15000000, 66000);
/* 9248x6944 @ 5, full array, 2500.8 Mbps/lane */
HADRON_EO_MODE(mode3, 9248, 6944, 500160000, 14339, 20.84, 5000000, 198000);
#endif

ports {
	#address-cells = <1>;
	#size-cells = <0>;
	port@0 {
		reg = <0>;
		hadron_eo_out0: endpoint {
			status = "okay";
			port-index = <HADRON_EO_PORT_INDEX>;
			bus-width = <HADRON_EO_LANES>;
			remote-endpoint = <&hadron_eo_csi_in0>;
		};
	};
};
